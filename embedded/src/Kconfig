## embedded/src/Kconfig
```kconfig
menu "Ephoros network and modem"

choice EPHOROS_NETWORK_BACKEND
    prompt "Network backend"
    default EPHOROS_NETWORK_CELLULAR
    help
        Select the network interface used by the application. Wi-Fi uses the
        ESP32 station interface; cellular uses the A7670G PPP interface.

config EPHOROS_NETWORK_CELLULAR
    bool "A7670G cellular modem (PPP)"

config EPHOROS_NETWORK_WIFI
    bool "Wi-Fi station"

endchoice

if EPHOROS_NETWORK_WIFI

config EPHOROS_WIFI_SSID
    string "Wi-Fi SSID"
    default ""
    help
        The access point name used by the ESP32 station interface.

config EPHOROS_WIFI_PASSWORD
    string "Wi-Fi password"
    default ""
    help
        WPA/WPA2 passphrase. This value is compiled into the firmware.
        Provision it from NVS instead for production devices.

endif

if EPHOROS_NETWORK_CELLULAR

choice EPHOROS_MODEM_DCE
    prompt "A7670G esp-modem command profile"
    default EPHOROS_MODEM_DCE_A7670G
    help
        The A7670 is not a dedicated esp-modem device type. Start with the
        generic implementation for PPP. Select SIM7600 compatibility only if
        the modem firmware requires its command extensions.

config EPHOROS_MODEM_DCE_A7670G
    bool "A7670G generic PPP profile (recommended)"

config EPHOROS_MODEM_DCE_SIM7600_COMPAT
    bool "SIM7600-compatible DCE"

endchoice

config EPHOROS_MODEM_APN
    string "Cellular APN"
    default "internet"
    help
        The access-point name supplied by the SIM provider.

choice EPHOROS_MODEM_PDP_TYPE
    prompt "PDP protocol type"
    default EPHOROS_MODEM_PDP_TYPE_IPV4

config EPHOROS_MODEM_PDP_TYPE_IPV4
    bool "IPv4 (IP)"

config EPHOROS_MODEM_PDP_TYPE_IPV4V6
    bool "Dual-stack IPv4/IPv6 (IPV4V6)"

config EPHOROS_MODEM_PDP_TYPE_IPV6
    bool "IPv6 only (IPV6)"

endchoice

config EPHOROS_MODEM_PDP_CONTEXT_ID
    int "PDP context ID"
    range 1 16
    default 1
    help
        Most carriers use context ID 1. Change this only when the SIM
        provider explicitly requires another context.

config EPHOROS_MODEM_SIM_PIN
    string "SIM PIN (leave empty when disabled)"
    default ""
    help
        This value is compiled into the firmware. Use it only during
        development; provision secrets from NVS in production.

config EPHOROS_MODEM_UART_BAUD_RATE
    int "Modem UART baud rate"
    range 9600 921600
    default 115200

config EPHOROS_MODEM_POWER_ON_DELAY_MS
    int "Delay after enabling modem power (ms)"
    range 0 30000
    default 500

config EPHOROS_MODEM_PULSE_PWRKEY
    bool "Pulse the modem power key at startup"
    default n
    help
        Enable only when the modem is not already started after GPIO12 is
        enabled. The power-key pulse is active low on this board.

config EPHOROS_MODEM_PWRKEY_PULSE_MS
    int "Power-key pulse duration (ms)"
    depends on EPHOROS_MODEM_PULSE_PWRKEY
    range 100 5000
    default 1000

endif

endmenu

menu "Ephoros CAN receiver"

config EPHOROS_CAN_ENABLED
    bool "Enable CAN receiver"
    default y
    help
        Start the ESP32 TWAI receiver. Disable this when developing without a
        CAN bus; the telemetry simulator can then provide synthetic signals.

config EPHOROS_CAN_SIMULATOR
    bool "Simulate CAN telemetry"
    depends on !EPHOROS_CAN_ENABLED
    default n
    help
        Generate values for the MQTT topics declared in config.dbc and feed
        them to InfluxDB. The topic catalog is generated at build time.

config EPHOROS_CAN_SIMULATOR_INTERVAL_MS
    int "Simulator sample interval (ms)"
    depends on EPHOROS_CAN_SIMULATOR
    default 1000
    range 10 60000

config EPHOROS_CAN_SIMULATOR_SEED
    int "Simulator random seed (0 = random at boot)"
    depends on EPHOROS_CAN_SIMULATOR
    default 0
    range 0 2147483647

config EPHOROS_CAN_RX_GPIO
    int "CAN RX GPIO"
    depends on EPHOROS_CAN_ENABLED
    default 18
    range 0 48
    help
        ESP32 GPIO connected to the RXD output of the CAN transceiver.

config EPHOROS_CAN_TX_GPIO
    int "CAN TX GPIO"
    depends on EPHOROS_CAN_ENABLED
    default 19
    range -1 48
    help
        ESP32 GPIO connected to the TXD input of the CAN transceiver. Set to
        -1 when using listen-only mode and no TX connection is needed.

config EPHOROS_CAN_BITRATE
    int "CAN bitrate (bit/s)"
    depends on EPHOROS_CAN_ENABLED
    default 500000
    range 10000 1000000

config EPHOROS_CAN_LISTEN_ONLY
    int "CAN mode (1 = listen-only, 0 = normal)"
    depends on EPHOROS_CAN_ENABLED
    default 1
    range 0 1
    help
        Set to 1 to receive frames without transmitting acknowledgements or
        error frames. Set to 0 only when this node must actively participate
        on the CAN bus.

config EPHOROS_CAN_RX_QUEUE_DEPTH
    int "Received-frame queue depth"
    depends on EPHOROS_CAN_ENABLED
    default 32
    range 1 256

config EPHOROS_CAN_DECODED_QUEUE_DEPTH
    int "Decoded-signal queue depth"
    depends on EPHOROS_CAN_ENABLED
    default 128
    range 1 1024
    help
        Number of decoded signals available to application tasks. New signals
        are dropped when this queue is full, keeping CAN reception nonblocking.

config EPHOROS_CAN_TASK_STACK_SIZE
    int "CAN decoder task stack size"
    depends on EPHOROS_CAN_ENABLED
    default 4096
    range 2048 16384

config EPHOROS_CAN_TASK_PRIORITY
    int "CAN decoder task priority"
    depends on EPHOROS_CAN_ENABLED
    default 5
    range 1 24

config EPHOROS_CAN_LOG_RECEIVED_FRAMES
    bool "Log received frame headers"
    depends on EPHOROS_CAN_ENABLED
    default n

config EPHOROS_CAN_VERA_DECODER
    bool "Decode frames with Vera"
    depends on EPHOROS_CAN_ENABLED
    default n
    help
        Generate Vera's ESP-IDF adapter with:
            vera -f path/to/network.dbc -sdk espidf embedded/generated
        Then enable this setting. Generated files are deliberately excluded
        until a project DBC is available.

endmenu

menu "InfluxDB telemetry"

config EPHOROS_INFLUXDB_WRITE_URL
	string "InfluxDB Write API URL"
	default "https://<host>/api/v2/write?org=<org>&bucket=<bucket>&precision=ms"
	help
		The complete InfluxDB 2.x Write API URL, including its organization,
		bucket, and precision query parameters. For example:
		https://influx.example.com/api/v2/write?org=apex&bucket=telemetry&precision=ns

config EPHOROS_INFLUXDB_TOKEN
	string "InfluxDB API token"
	default ""
	help
		An API token with write permission for the configured bucket. This value
		is stored in sdkconfig, so do not commit a production token. Prefer NVS
		or another device-provisioning mechanism for production firmware.

config EPHOROS_INFLUXDB_TIMEOUT_MS
	int "HTTP write timeout (ms)"
	default 10000
	range 1000 60000
	help
		Maximum time allowed for one InfluxDB write request.

endmenu
```
